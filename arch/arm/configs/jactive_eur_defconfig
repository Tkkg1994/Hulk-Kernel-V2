## arch/arm/configs/jactive_eur_defconfig
```kconfig
CONFIG_MACH_JACTIVE_EUR=y
CONFIG_EXTRA_FIRMWARE="audience-es325-fw-jactive-eur.bin"
CONFIG_EXTRA_FIRMWARE_DIR="firmware"
CONFIG_CFG80211_REG_NOT_UPDATED=y
CONFIG_CRYPTO_NULL=y
CONFIG_TOUCHSCREEN_ATMEL_MXTS=n

CONFIG_FB_MSM_MIPI_RENESAS_TFT_VIDEO_FULL_HD_PT_PANEL=y
CONFIG_DISPLAY_DISABLE_TEST_KEY=y
CONFIG_SUPPORT_DISPLAY_OCTA_TFT=y
CONFIG_FB_MSM_ENABLE_LCD_EN2=y
CONFIG_ESD_ERR_FG_RECOVERY=y
# CONFIG_FB_MSM_MIPI_SAMSUNG_OCTA_VIDEO_FULL_HD_PT_PANEL is not set
# CONFIG_LCD_VDD3_BY_PMGPIO is not set

# TSP
CONFIG_TOUCHSCREEN_SYNAPTICS_PREVENT_HSYNC_LEAKAGE=y
# Wifi features
CONFIG_WCNSS_CORE=n
CONFIG_WIRELESS_EXT=n
CONFIG_PRIMA_WLAN=n
# Camera
CONFIG_S5K3H5XA=y
CONFIG_CAMERA_SW_I2C_ACT=y
CONFIG_IMX175_EEPROM=y

# RTCC
CONFIG_ZRAM=n
CONFIG_RUNTIME_COMPCACHE=n

# Samsung ODE
CONFIG_FORCE_DISABLE_FIPS=y

CONFIG_SEC_NET_FILTER=y

# SAMP : HOTNESS
CONFIG_SAMP_HOTNESS=y
```

## arch/arm/configs/jfve_eur_defconfig
```kconfig
# CONFIG_MACH_JF_EUR is not set
CONFIG_MACH_JFVE_EUR=y
CONFIG_MACH_JFVE_EUR_LTE=y
CONFIG_EXTRA_FIRMWARE="audience-es325-fw-eur.bin"
CONFIG_EXTRA_FIRMWARE_DIR="firmware"
CONFIG_CFG80211_REG_NOT_UPDATED=y
CONFIG_CRYPTO_NULL=y
CONFIG_TOUCHSCREEN_ATMEL_MXTS=n
CONFIG_MHL_VERSION=0x21
# CONFIG_MMC_MSM_SDC4_SUPPORT is not set
# CONFIG_MMC_MSM_SDC2_SUPPORT is not set

# SSWAP
CONFIG_SWAP=y
CONFIG_FRONTSWAP=y
CONFIG_ZSMALLOC_NEW=y
CONFIG_PGTABLE_MAPPING=y
CONFIG_ZSWAP=y
CONFIG_DIRECT_RECLAIM_FILE_PAGES_ONLY=y
CONFIG_INCREASE_MAXIMUM_SWAPPINESS=y
CONFIG_FIX_INACTIVE_RATIO=y
CONFIG_TIGHT_PGDAT_BALANCE=y
CONFIG_VNSWAP=y
CONFIG_SWAP_ENABLE_READAHEAD=n

# RTCC
CONFIG_RUNTIME_COMPCACHE=n

# Samsung ODE
CONFIG_FORCE_DISABLE_FIPS=y

CONFIG_SEC_NET_FILTER=y

# SAMP : HOTNESS
CONFIG_SAMP_HOTNESS=y


# wlan&bt stuff
CONFIG_WCNSS_CORE=y
CONFIG_MSM_PIL_RIVA=y
CONFIG_MSM_WCNSS_SSR_8960=y
CONFIG_WCNSS_MEM_PRE_ALLOC=y
# CONFIG_BCM4335 is not set
# CONFIG_BROADCOM_WIFI_RESERVED_MEM is not set
# CONFIG_WLAN_REGION_CODE is not set
# CONFIG_BCMDHD_FW_PATH is not set
# CONFIG_BCMDHD_NVRAM_PATH is not set
# CONFIG_CFG80211_ALLOW_RECONNECT is not set
# CONFIG_BT_BCM4335 is not set
```
